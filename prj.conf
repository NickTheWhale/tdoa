## CMakeLists.txt
```
cmake_minimum_required(VERSION 3.20.0)
find_package(Zephyr REQUIRED HINTS $ENV{ZEPHYR_BASE})

project(tdoa)

target_sources(app PRIVATE
    src/cli.c
    src/config.c
    src/hashmap.c
    src/main.c
    src/uwb_anchor.c
    src/uwb_dummy.c
    src/uwb_tag.c
    src/uwb_utils.c
    src/uwb.c

    dw1000/src/deca_device.c
    dw1000/src/deca_mutex.c
    dw1000/src/deca_params_init.c
    dw1000/src/deca_range_tables.c
    dw1000/src/deca_sleep.c
    dw1000/src/deca_spi.c
    dw1000/src/port.c
)

target_include_directories(app PRIVATE
    dw1000/include
    include
)

target_compile_definitions(app PRIVATE
    DWT_API_ERROR_CHECK
)
```

## west.yml
```
manifest:
  self:
    path: application
  remotes:
    - name: nrf
      url-base: https://github.com/nrfconnect
  projects:
    - name: sdk-nrf
      remote: nrf
      path: nrf
      revision: v2.6.0
      import:
        path-prefix: external
      clone-depth: 1
```

## prj.conf
```kconfig
CONFIG_SPI=y
CONFIG_PM_DEVICE=y
CONFIG_CBPRINTF_FP_SUPPORT=y

CONFIG_LOG=y
# CONFIG_LOG_MODE_MINIMAL=y
CONFIG_SHELL=y
# CONFIG_SHELL_MINIMAL=y
CONFIG_FLASH=y
CONFIG_NVS=y
CONFIG_CRC=y

CONFIG_TEST_RANDOM_GENERATOR=y

CONFIG_DEBUG_OPTIMIZATIONS=y
CONFIG_MISRA_SANE=y
CONFIG_COMPILER_WARNINGS_AS_ERRORS=y

CONFIG_DEBUG_THREAD_INFO=y
```

## decawave_dwm1001_dev.overlay
```dts
// To get started, press Ctrl+Space to bring up the completion menu and view the available nodes.

// You can also use the buttons in the sidebar to perform actions on nodes.
// Actions currently available include:

// * Enabling / disabling the node
// * Adding the bus to a bus
// * Removing the node
// * Connecting ADC channels

// For more help, browse the DeviceTree documentation at https://docs.zephyrproject.org/latest/guides/dts/index.html
// You can also visit the nRF DeviceTree extension documentation at https://nrfconnect.github.io/vscode-nrf-connect/devicetree/nrfdevicetree.html


// git test
```

## src/main.c
```c
/**
 * @file main.c
 * @author Nicholas Loehrke (nicholasnloehrke@gmail.com)
 * @brief
 * @version 1.0.0
 * @date 2024-03-19
 *
 * MIT License
 *
 * Copyright (c) 2024 Nicholas Loehrke
 *
 * Permission is hereby granted, free of charge, to any person obtaining a copy
 * of this software and associated documentation files (the "Software"), to deal
 * in the Software without restriction, including without limitation the rights
 * to use, copy, modify, merge, publish, distribute, sublicense, and/or sell
 * copies of the Software, and to permit persons to whom the Software is
 * furnished to do so, subject to the following conditions:
 *
 * The above copyright notice and this permission notice shall be included in all
 * copies or substantial portions of the Software.
 *
 * THE SOFTWARE IS PROVIDED "AS IS", WITHOUT WARRANTY OF ANY KIND, EXPRESS OR
 * IMPLIED, INCLUDING BUT NOT LIMITED TO THE WARRANTIES OF MERCHANTABILITY,
 * FITNESS FOR A PARTICULAR PURPOSE AND NONINFRINGEMENT. IN NO EVENT SHALL THE
 * AUTHORS OR COPYRIGHT HOLDERS BE LIABLE FOR ANY CLAIM, DAMAGES OR OTHER
 * LIABILITY, WHETHER IN AN ACTION OF CONTRACT, TORT OR OTHERWISE, ARISING FROM,
 * OUT OF OR IN CONNECTION WITH THE SOFTWARE OR THE USE OR OTHER DEALINGS IN THE
 * SOFTWARE.
 *
 */

#include "config.h"
#include "deca_device_api.h"
#include "hashmap.h"
#include "uwb.h"

#include <zephyr/logging/log.h>
#include <zephyr/random/random.h>
#include <zephyr/shell/shell.h>
#include <zephyr/sys/crc.h>

LOG_MODULE_REGISTER(main, LOG_LEVEL_DBG);

int main(void)
{
    k_msleep(1000);

    int ret;
    ret = config_init();
    if (ret != 0)
    {
        LOG_ERR("Failed to initialize config: %d", ret);
        return -1;
    }

    ret = uwb_init();
    if (ret != 0)
    {
        LOG_ERR("Failed to initalize uwb: %d", ret);
        return -2;
    }

    LOG_DBG("Initialized uwb");

    hash_init();

    uwb_start();

    return 0;
}
```

## include/cli.h
```c
/**
 * @file cli.h
 * @author Nicholas Loehrke (nicholasnloehrke@gmail.com)
 * @brief
 * @version 1.0.0
 * @date 2024-03-19
 *
 * MIT License
 *
 * Copyright (c) 2024 Nicholas Loehrke
 *
 * Permission is hereby granted, free of charge, to any person obtaining a copy
 * of this software and associated documentation files (the "Software"), to deal
 * in the Software without restriction, including without limitation the rights
 * to use, copy, modify, merge, publish, distribute, sublicense, and/or sell
 * copies of the Software, and to permit persons to whom the Software is
 * furnished to do so, subject to the following conditions:
 *
 * The above copyright notice and this permission notice shall be included in all
 * copies or substantial portions of the Software.
 *
 * THE SOFTWARE IS PROVIDED "AS IS", WITHOUT WARRANTY OF ANY KIND, EXPRESS OR
 * IMPLIED, INCLUDING BUT NOT LIMITED TO THE WARRANTIES OF MERCHANTABILITY,
 * FITNESS FOR A PARTICULAR PURPOSE AND NONINFRINGEMENT. IN NO EVENT SHALL THE
 * AUTHORS OR COPYRIGHT HOLDERS BE LIABLE FOR ANY CLAIM, DAMAGES OR OTHER
 * LIABILITY, WHETHER IN AN ACTION OF CONTRACT, TORT OR OTHERWISE, ARISING FROM,
 * OUT OF OR IN CONNECTION WITH THE SOFTWARE OR THE USE OR OTHER DEALINGS IN THE
 * SOFTWARE.
 *
 */

#ifndef __CLI_H__
#define __CLI_H__

#endif // CLI_H
```

## include/config.h
```c
/**
 * @file config.h
 * @author Nicholas Loehrke (nicholasnloehrke@gmail.com)
 * @brief
 * @version 1.0.0
 * @date 2024-03-19
 *
 * MIT License
 *
 * Copyright (c) 2024 Nicholas Loehrke
 *
 * Permission is hereby granted, free of charge, to any person obtaining a copy
 * of this software and associated documentation files (the "Software"), to deal
 * in the Software without restriction, including without limitation the rights
 * to use, copy, modify, merge, publish, distribute, sublicense, and/or sell
 * copies of the Software, and to permit persons to whom the Software is
 * furnished to do so, subject to the following conditions:
 *
 * The above copyright notice and this permission notice shall be included in all
 * copies or substantial portions of the Software.
 *
 * THE SOFTWARE IS PROVIDED "AS IS", WITHOUT WARRANTY OF ANY KIND, EXPRESS OR
 * IMPLIED, INCLUDING BUT NOT LIMITED TO THE WARRANTIES OF MERCHANTABILITY,
 * FITNESS FOR A PARTICULAR PURPOSE AND NONINFRINGEMENT. IN NO EVENT SHALL THE
 * AUTHORS OR COPYRIGHT HOLDERS BE LIABLE FOR ANY CLAIM, DAMAGES OR OTHER
 * LIABILITY, WHETHER IN AN ACTION OF CONTRACT, TORT OR OTHERWISE, ARISING FROM,
 * OUT OF OR IN CONNECTION WITH THE SOFTWARE OR THE USE OR OTHER DEALINGS IN THE
 * SOFTWARE.
 *
 */

#ifndef __CONFIG_H__
#define __CONFIG_H__

#include <stddef.h>
#include <stdint.h>

#define CONFIG_SIZE_BUFFER 128

typedef enum
{
    CONFIG_FIELD_MODE = 0,
    CONFIG_FIELD_ADDRESS,
    CONFIG_FIELD_ANCHOR_X_POS_MM,
    CONFIG_FIELD_ANCHOR_Y_POS_MM,
    CONFIG_FIELD_MAX
} config_field_t;

int config_init();
int config_erase();
int config_refresh();
void config_buffer(uint8_t *buffer, size_t size);

int config_field_size(config_field_t field, uint8_t *size);

int config_read_u8(config_field_t field, uint8_t *value);
int config_read_u16(config_field_t field, uint16_t *value);
int config_read_u32(config_field_t field, uint32_t *value);
int config_read_u64(config_field_t field, uint64_t *value);
int config_read_float(config_field_t field, float *value);
int config_read_double(config_field_t field, double *value);

int config_write_u8(config_field_t field, uint8_t value);
int config_write_u16(config_field_t field, uint16_t value);
int config_write_u32(config_field_t field, uint32_t value);
int config_write_u64(config_field_t field, uint64_t value);
int config_write_float(config_field_t field, float value);
int config_write_double(config_field_t field, double value);

int config_read_u8_array(config_field_t field, uint8_t length, uint8_t *array);
int config_read_u16_array(config_field_t field, uint8_t length, uint16_t *array);
int config_read_u32_array(config_field_t field, uint8_t length, uint32_t *array);
int config_read_u64_array(config_field_t field, uint8_t length, uint64_t *array);
int config_read_float_array(config_field_t field, uint8_t length, float *array);
int config_read_double_array(config_field_t field, uint8_t length, double *array);

int config_write_u8_array(config_field_t field, uint8_t length, uint8_t *array);
int config_write_u16_array(config_field_t field, uint8_t length, uint16_t *array);
int config_write_u32_array(config_field_t field, uint8_t length, uint32_t *array);
int config_write_u64_array(config_field_t field, uint8_t length, uint64_t *array);
int config_write_float_array(config_field_t field, uint8_t length, float *array);
int config_write_double_array(config_field_t field, uint8_t length, double *array);

#endif // __CONFIG_H__
```

## include/hashmap.h
```c
/**
 * @file hashmap.h
 * @author Nicholas Loehrke (nicholasnloehrke@gmail.com)
 * @brief
 * @version 1.0.0
 * @date 2024-04-11
 *
 * MIT License
 *
 * Copyright (c) 2024 Nicholas Loehrke
 *
 * Permission is hereby granted, free of charge, to any person obtaining a copy
 * of this software and associated documentation files (the "Software"), to deal
 * in the Software without restriction, including without limitation the rights
 * to use, copy, modify, merge, publish, distribute, sublicense, and/or sell
 * copies of the Software, and to permit persons to whom the Software is
 * furnished to do so, subject to the following conditions:
 *
 * The above copyright notice and this permission notice shall be included in all
 * copies or substantial portions of the Software.
 *
 * THE SOFTWARE IS PROVIDED "AS IS", WITHOUT WARRANTY OF ANY KIND, EXPRESS OR
 * IMPLIED, INCLUDING BUT NOT LIMITED TO THE WARRANTIES OF MERCHANTABILITY,
 * FITNESS FOR A PARTICULAR PURPOSE AND NONINFRINGEMENT. IN NO EVENT SHALL THE
 * AUTHORS OR COPYRIGHT HOLDERS BE LIABLE FOR ANY CLAIM, DAMAGES OR OTHER
 * LIABILITY, WHETHER IN AN ACTION OF CONTRACT, TORT OR OTHERWISE, ARISING FROM,
 * OUT OF OR IN CONNECTION WITH THE SOFTWARE OR THE USE OR OTHER DEALINGS IN THE
 * SOFTWARE.
 *
 */

#ifndef __HASHMAP_H__
#define __HASHMAP_H__

#include <stdbool.h>
#include <stddef.h>
#include <stdint.h>

#define HASH_KEY_SIZE 8
#define HASH_CAPACITY 64

typedef struct
{
    int n;
} anchor_context_t;


typedef anchor_context_t hash_value_t;

void hash_init();
int hash_insert(uint8_t key[HASH_KEY_SIZE], hash_value_t *value);
int hash_get(uint8_t key[HASH_KEY_SIZE], hash_value_t *value);
int hash_remove(uint8_t key[HASH_KEY_SIZE]);
bool hash_empty();
size_t hash_available();

// testing code
void hash_printk();

#endif // __HASHMAP_H__
```

## include/mac.h
```c
/**
 * @file mac.h
 * @author Nicholas Loehrke (nicholasnloehrke@gmail.com)
 * @brief
 * @version 1.0.0
 * @date 2024-03-19
 *
 * MIT License
 *
 * Copyright (c) 2024 Nicholas Loehrke
 *
 * Permission is hereby granted, free of charge, to any person obtaining a copy
 * of this software and associated documentation files (the "Software"), to deal
 * in the Software without restriction, including without limitation the rights
 * to use, copy, modify, merge, publish, distribute, sublicense, and/or sell
 * copies of the Software, and to permit persons to whom the Software is
 * furnished to do so, subject to the following conditions:
 *
 * The above copyright notice and this permission notice shall be included in all
 * copies or substantial portions of the Software.
 *
 * THE SOFTWARE IS PROVIDED "AS IS", WITHOUT WARRANTY OF ANY KIND, EXPRESS OR
 * IMPLIED, INCLUDING BUT NOT LIMITED TO THE WARRANTIES OF MERCHANTABILITY,
 * FITNESS FOR A PARTICULAR PURPOSE AND NONINFRINGEMENT. IN NO EVENT SHALL THE
 * AUTHORS OR COPYRIGHT HOLDERS BE LIABLE FOR ANY CLAIM, DAMAGES OR OTHER
 * LIABILITY, WHETHER IN AN ACTION OF CONTRACT, TORT OR OTHERWISE, ARISING FROM,
 * OUT OF OR IN CONNECTION WITH THE SOFTWARE OR THE USE OR OTHER DEALINGS IN THE
 * SOFTWARE.
 *
 */

#ifndef __PACKET_H__
#define __PACKET_H__

#include "uwb.h"

#include <assert.h>
#include <stdint.h>
#include <string.h>

#define MAC80215_PACKET_SIZE (sizeof(mac_packet_t))
#define MAC802154_PACKET_HEADER_SIZE 21
#define MAC80215_PACKET_PAYLOAD_SIZE 128
#define MAC80215_PACKET_PAYLOAD_SIZE_USABLE 126

// Packet format with compressed PAN and 64Bit addresses
// Maximum 128 bytes payload (last two bytes are reserved for deca checksum, so 126 bytes usable)
typedef struct __packed
{
    union {
        uint16_t raw;
        struct
        {
            uint16_t frame_type : 3;
            uint16_t security_enabled : 1;
            uint16_t frame_pending : 1;
            uint16_t ack_required : 1;
            uint16_t pan_id : 1;
            uint16_t reserved : 3;
            uint16_t dest_addr_mode : 2;
            uint16_t frame_version : 2;
            uint16_t src_addr_mode : 2;
        } fields;
    } frame_control;

    uint8_t sequence_number;
    uint16_t dest_pan_id;
    uint8_t dest_address[8];
    uint8_t src_address[8];

    uint8_t payload[MAC80215_PACKET_PAYLOAD_SIZE];
    // uint8_t deca_checksum[2];
} mac_packet_t;

typedef enum
{
    MAC802154_TYPE_BEACON = 0,
    MAC802154_TYPE_DATA,
    MAC802154_TYPE_ACK,
    MAC802154_TYPE_CMD
} mac_packet_type_t;

/**
 * @brief Initialize packet header
 * @param packet: pointer to mac_packet_t packet
 * @param type: mac_packet_type_t type
 */
#define MAC80215_PACKET_INIT(packet, type)                   \
    do                                                       \
    {                                                        \
        (packet)->frame_control.fields.frame_type = (type);  \
        (packet)->frame_control.fields.security_enabled = 0; \
        (packet)->frame_control.fields.frame_pending = 0;    \
        (packet)->frame_control.fields.ack_required = 0;     \
        (packet)->frame_control.fields.pan_id = 1;           \
        (packet)->frame_control.fields.dest_addr_mode = 3;   \
        (packet)->frame_control.fields.frame_version = 1;    \
        (packet)->frame_control.fields.src_addr_mode = 3;    \
    } while (0)

/**
 * @brief LOG_DBG packet contents
 * @param packet: pointer to mac_packet_t packet
 */
#define MAC80215_LOG_PACKET(packet)                                                   \
    LOG_DBG("frame_type: %u", (packet)->frame_control.fields.frame_type);             \
    LOG_DBG("security_enabled: %u", (packet)->frame_control.fields.security_enabled); \
    LOG_DBG("frame_pending: %u", (packet)->frame_control.fields.frame_pending);       \
    LOG_DBG("ack_required: %u", (packet)->frame_control.fields.ack_required);         \
    LOG_DBG("pan_id: %u", (packet)->frame_control.fields.pan_id);                     \
    LOG_DBG("reserved: %u", (packet)->frame_control.fields.reserved);                 \
    LOG_DBG("dest_addr_mode: %u", (packet)->frame_control.fields.dest_addr_mode);     \
    LOG_DBG("frame_version: %u", (packet)->frame_control.fields.frame_version);       \
    LOG_DBG("src_addr_mode: %u", (packet)->frame_control.fields.src_addr_mode);       \
    LOG_DBG("sequence_number: %u", (packet)->sequence_number);                        \
    LOG_DBG("dest_pan_id: %u", (packet)->dest_pan_id);                                \
    LOG_HEXDUMP_DBG((packet)->dest_address, 8, "dest_address");                       \
    LOG_HEXDUMP_DBG((packet)->src_address, 8, "src_address");                         \
    LOG_HEXDUMP_DBG((packet)->payload, MAC80215_PACKET_PAYLOAD_SIZE, "payload");      \
    LOG_HEXDUMP_DBG((packet)->deca_checksum, 2, "deca_checksum");

#endif // PACKET_H
```

## include/uwb.h
```c
/**
 * @file uwb.h
 * @author Nicholas Loehrke (nicholasnloehrke@gmail.com)
 * @brief
 * @version 1.0.0
 * @date 2024-03-19
 *
 * MIT License
 *
 * Copyright (c) 2024 Nicholas Loehrke
 *
 * Permission is hereby granted, free of charge, to any person obtaining a copy
 * of this software and associated documentation files (the "Software"), to deal
 * in the Software without restriction, including without limitation the rights
 * to use, copy, modify, merge, publish, distribute, sublicense, and/or sell
 * copies of the Software, and to permit persons to whom the Software is
 * furnished to do so, subject to the following conditions:
 *
 * The above copyright notice and this permission notice shall be included in all
 * copies or substantial portions of the Software.
 *
 * THE SOFTWARE IS PROVIDED "AS IS", WITHOUT WARRANTY OF ANY KIND, EXPRESS OR
 * IMPLIED, INCLUDING BUT NOT LIMITED TO THE WARRANTIES OF MERCHANTABILITY,
 * FITNESS FOR A PARTICULAR PURPOSE AND NONINFRINGEMENT. IN NO EVENT SHALL THE
 * AUTHORS OR COPYRIGHT HOLDERS BE LIABLE FOR ANY CLAIM, DAMAGES OR OTHER
 * LIABILITY, WHETHER IN AN ACTION OF CONTRACT, TORT OR OTHERWISE, ARISING FROM,
 * OUT OF OR IN CONNECTION WITH THE SOFTWARE OR THE USE OR OTHER DEALINGS IN THE
 * SOFTWARE.
 *
 */

#ifndef __UWB_H__
#define __UWB_H__

#include "config.h"

#include <assert.h>
#include <stddef.h>
#include <stdint.h>

#define UWB_TIMEOUT_MAXIMUM 0xFFFFFFFFUL;
#define UWB_PAN_ID 0xBEEF

typedef struct
{
    uint8_t mode;
    uint8_t address[8];
    uint32_t anchor_x_pos_mm;
    uint32_t anchor_y_pos_mm;
} uwb_config_t;

typedef enum
{
    UWB_MODE_TAG = 0,
    UWB_MODE_ANCHOR,
    UWB_MODE_DUMMY,
    UWB_MODE_MAX
} uwb_mode_t;

typedef enum
{
    UWB_EVENT_TIMEOUT = 0,
    UWB_EVENT_PACKET_RECEIVED,
    UWB_EVENT_PACKET_SENT,
    UWB_EVENT_RECEIVE_TIMEOUT,
    UWB_EVENT_RECEIVE_FAILED
} uwb_event_t;

typedef enum
{
    UWB_PACKET_TYPE_SYNC = 0,
    UWB_PACKET_TYPE_MAX
} uwb_packet_type_t;

_Static_assert(UWB_PACKET_TYPE_MAX < 8, "Too many uwb packet types");

typedef struct
{
    void (*init)(uwb_config_t *config);
    uint32_t (*on_event)(uwb_event_t event);
} uwb_algorithm_t;

int uwb_init();
void uwb_start();
int uwb_mode_count();
char *uwb_mode_name(uwb_mode_t mode);

#endif // UWB_H
```

## include/uwb_utils.h
```c
/**
 * @file uwb_utils.h
 * @author Nicholas Loehrke (nicholasnloehrke@gmail.com)
 * @brief
 * @version 1.0.0
 * @date 2024-03-19
 *
 * MIT License
 *
 * Copyright (c) 2024 Nicholas Loehrke
 *
 * Permission is hereby granted, free of charge, to any person obtaining a copy
 * of this software and associated documentation files (the "Software"), to deal
 * in the Software without restriction, including without limitation the rights
 * to use, copy, modify, merge, publish, distribute, sublicense, and/or sell
 * copies of the Software, and to permit persons to whom the Software is
 * furnished to do so, subject to the following conditions:
 *
 * The above copyright notice and this permission notice shall be included in all
 * copies or substantial portions of the Software.
 *
 * THE SOFTWARE IS PROVIDED "AS IS", WITHOUT WARRANTY OF ANY KIND, EXPRESS OR
 * IMPLIED, INCLUDING BUT NOT LIMITED TO THE WARRANTIES OF MERCHANTABILITY,
 * FITNESS FOR A PARTICULAR PURPOSE AND NONINFRINGEMENT. IN NO EVENT SHALL THE
 * AUTHORS OR COPYRIGHT HOLDERS BE LIABLE FOR ANY CLAIM, DAMAGES OR OTHER
 * LIABILITY, WHETHER IN AN ACTION OF CONTRACT, TORT OR OTHERWISE, ARISING FROM,
 * OUT OF OR IN CONNECTION WITH THE SOFTWARE OR THE USE OR OTHER DEALINGS IN THE
 * SOFTWARE.
 *
 */

#ifndef __UWB_UTILS__
#define __UWB_UTILS__

#include <stdint.h>

uint64_t uwb_utils_timestamp_to_u64(uint8_t *timestamp_buffer);

#endif // __UWB_UTILS__
```

## src/cli.c
```c
/**
 * @file cli.c
 * @author Nicholas Loehrke (nicholasnloehrke@gmail.com)
 * @brief
 * @version 1.0.0
 * @date 2024-03-19
 *
 * MIT License
 *
 * Copyright (c) 2024 Nicholas Loehrke
 *
 * Permission is hereby granted, free of charge, to any person obtaining a copy
 * of this software and associated documentation files (the "Software"), to deal
 * in the Software without restriction, including without limitation the rights
 * to use, copy, modify, merge, publish, distribute, sublicense, and/or sell
 * copies of the Software, and to permit persons to whom the Software is
 * furnished to do so, subject to the following conditions:
 *
 * The above copyright notice and this permission notice shall be included in all
 * copies or substantial portions of the Software.
 *
 * THE SOFTWARE IS PROVIDED "AS IS", WITHOUT WARRANTY OF ANY KIND, EXPRESS OR
 * IMPLIED, INCLUDING BUT NOT LIMITED TO THE WARRANTIES OF MERCHANTABILITY,
 * FITNESS FOR A PARTICULAR PURPOSE AND NONINFRINGEMENT. IN NO EVENT SHALL THE
 * AUTHORS OR COPYRIGHT HOLDERS BE LIABLE FOR ANY CLAIM, DAMAGES OR OTHER
 * LIABILITY, WHETHER IN AN ACTION OF CONTRACT, TORT OR OTHERWISE, ARISING FROM,
 * OUT OF OR IN CONNECTION WITH THE SOFTWARE OR THE USE OR OTHER DEALINGS IN THE
 * SOFTWARE.
 *
 */

#include "config.h"
#include "uwb.h"

#include <stdint.h>
#include <stdio.h>
#include <zephyr/shell/shell.h>

static int cmd_config_dump(const struct shell *shell, size_t argc, char **argv)
{
    uint8_t buffer[CONFIG_SIZE_BUFFER];
    config_buffer(buffer, CONFIG_SIZE_BUFFER);
    shell_hexdump(shell, buffer, CONFIG_SIZE_BUFFER);

    return 0;
}

static int cmd_config_print(const struct shell *shell, size_t argc, char **argv)
{
    shell_warn(shell, "NOT IMPLEMENTED");

    return 0;
}

static int cmd_config_erase(const struct shell *shell, size_t argc, char **argv)
{
    if (config_erase() != 0)
    {
        shell_error(shell, "Failed to erase flash");
        return -1;
    }

    return 0;
}

static int cmd_config_mode(const struct shell *shell, size_t argc, char **argv)
{
    int ret;
    if (argc > 1)
    {
        if (strcmp(argv[1], "tag") == 0 || strcmp(argv[1], "0") == 0)
        {
            argv[1] = "tag";
            ret = config_write_u8(CONFIG_FIELD_MODE, UWB_MODE_TAG);
        }
        else if (strcmp(argv[1], "anchor") == 0 || strcmp(argv[1], "1") == 0)
        {
            argv[1] = "anchor";
            ret = config_write_u8(CONFIG_FIELD_MODE, UWB_MODE_ANCHOR);
        }
        else
        {
            ret = -1;
        }

        if (ret != 0)
        {
            shell_error(shell, "Failed to set UWB mode to '%s'", argv[1]);
            return -1;
        }
        else
        {
            shell_info(shell, "Set UWB mode to '%s'", argv[1]);
        }
    }
    else
    {
        uint8_t mode;
        ret = config_read_u8(CONFIG_FIELD_MODE, &mode);
        if (ret != 0)
        {
            shell_error(shell, "Failed to retrieve current UWB mode");
            return -2;
        }
        else
        {
            shell_info(shell, "Current UWB mode is '%s'", uwb_mode_name(mode));
        }
    }

    return 0;
}

static int cmd_config_address(const struct shell *shell, size_t argc, char **argv)
{
    if (argc > 1)
    {
        char *str = argv[1];
        char *token;
        char *rest = str;

        uint8_t new_address[8];
        int i = 0;
        while ((token = strtok_r(rest, ":;,.", &rest)) && i < 8)
        {
            int err = 0;
            unsigned long value = shell_strtoul(token, 16, &err);
            if (err != 0)
            {
                shell_error(shell, "Invalid address format. Failed at '%s'", token);
                return -1;
            }

            if (value > 0xff)
            {
                shell_error(shell, "Invalid address format at '0x%lx'", value);
                return -2;
            }

            new_address[i] = value;

            ++i;
        }

        if (i != 8)
        {
            shell_error(shell, "Invalid address length. Got '%u', expected '%u'", i, 8);
            return -3;
        }

        if (config_write_u8_array(CONFIG_FIELD_ADDRESS, 8, new_address) != 0)
        {
            shell_error(shell, "Failed to write address to config");
            return -4;
        }

        uint8_t address[8];
        if (config_read_u8_array(CONFIG_FIELD_ADDRESS, 8, address) != 0)
        {
            shell_error(shell, "Failed to re-read address from config");
        }

        shell_fprintf(shell, SHELL_VT100_COLOR_GREEN, "Set UWB address to ");
        i = 0;
        for (; i < 7; ++i)
        {
            shell_fprintf(shell, SHELL_VT100_COLOR_GREEN, "%x:", address[i]);
        }
        shell_fprintf(shell, SHELL_VT100_COLOR_GREEN, "%x\n", address[i]);
    }
    else
    {
        uint8_t address[8];
        if (config_read_u8_array(CONFIG_FIELD_ADDRESS, 8, address) != 0)
        {
            shell_error(shell, "Failed to retrieve current address");
            return -4;
        }

        shell_fprintf(shell, SHELL_VT100_COLOR_GREEN, "Current UWB address is ");
        int i = 0;
        for (; i < 7; ++i)
        {
            shell_fprintf(shell, SHELL_VT100_COLOR_GREEN, "%x:", address[i]);
        }
        shell_fprintf(shell, SHELL_VT100_COLOR_GREEN, "%x\n", address[i]);
    }
    return 0;
}

static int cmd_config_anchor_position(const struct shell *shell, size_t argc, char **argv)
{
    if (!(argc == 1 || argc == 3))
    {
        shell_error(shell, "Invalid usage. Expected 0 or 2 arguments");
        return -1;
    }
    if (argc > 2)
    {
        uint32_t new_x, new_y, old_x, old_y;
        int err = 0;
        new_x = shell_strtoul(argv[1], 10, &err);
        if (err != 0)
        {
            shell_error(shell, "Invalid format for 'x' coordinate");
            return -2;
        }
        new_y = shell_strtoul(argv[2], 10, &err);
        if (err != 0)
        {
            shell_error(shell, "Invalid format for 'y' coordinate");
            return -3;
        }
        if (config_write_u32(CONFIG_FIELD_ANCHOR_X_POS_MM, new_x) != 0)
        {
            shell_error(shell, "Failed to write 'x' coordinate");
            return -4;
        }
        if (config_write_u32(CONFIG_FIELD_ANCHOR_Y_POS_MM, new_y) != 0)
        {
            shell_error(shell, "Failed to write 'y' coordinate");
            return -5;
        }
        if (config_read_u32(CONFIG_FIELD_ANCHOR_X_POS_MM, &old_x) != 0)
        {
            shell_error(shell, "Failed to re-read 'x' coordinate");
            return -6;
        }
        if (config_read_u32(CONFIG_FIELD_ANCHOR_Y_POS_MM, &old_y) != 0)
        {
            shell_error(shell, "Failed to re-read 'y' coordinate");
            return -7;
        }
        if (old_x != new_x || old_y != new_y)
        {
            shell_error(shell, "Failed to write coordinates");
            return -8;
        }

        shell_info(shell, "Set coordinates to x: %u, y: %u", new_x, new_y);
        return 0;
    }
    else if (argc == 1)
    {
        uint32_t x, y;
        if (config_read_u32(CONFIG_FIELD_ANCHOR_X_POS_MM, &x) != 0 || config_read_u32(CONFIG_FIELD_ANCHOR_Y_POS_MM, &y) != 0)
        {
            shell_error(shell, "Failed to read anchor position");
            return -9;
        }
        shell_info(shell, "x: %u (mm), y: %u (mm)", x, y);
    }
    return 0;
}

SHELL_STATIC_SUBCMD_SET_CREATE(config_sub,
                               SHELL_CMD(dump, NULL, "Dump configuration in hexadecimal format", cmd_config_dump),
                               SHELL_CMD(print, NULL, "Print configuration in human-readable format", cmd_config_print),
                               SHELL_CMD(erase, NULL, "Erase configuration from flash", cmd_config_erase),
                               SHELL_CMD_ARG(mode, NULL, "Set/Get UWB mode", cmd_config_mode, 1, 1),
                               SHELL_CMD_ARG(address, NULL, "Set/Get UWB address", cmd_config_address, 1, 1),
                               SHELL_CMD_ARG(anchor_position, NULL, "Set/Get UWB anchor position", cmd_config_anchor_position, 1, 2),
                               SHELL_SUBCMD_SET_END);

SHELL_CMD_REGISTER(config, &config_sub, "Configuration commands", NULL);
```

## src/config.c
```c
/**
 * @file config.c
 * @author Nicholas Loehrke (nicholasnloehrke@gmail.com)
 * @brief
 * @version 1.0.0
 * @date 2024-03-19
 *
 * MIT License
 *
 * Copyright (c) 2024 Nicholas Loehrke
 *
 * Permission is hereby granted, free of charge, to any person obtaining a copy
 * of this software and associated documentation files (the "Software"), to deal
 * in the Software without restriction, including without limitation the rights
 * to use, copy, modify, merge, publish, distribute, sublicense, and/or sell
 * copies of the Software, and to permit persons to whom the Software is
 * furnished to do so, subject to the following conditions:
 *
 * The above copyright notice and this permission notice shall be included in all
 * copies or substantial portions of the Software.
 *
 * THE SOFTWARE IS PROVIDED "AS IS", WITHOUT WARRANTY OF ANY KIND, EXPRESS OR
 * IMPLIED, INCLUDING BUT NOT LIMITED TO THE WARRANTIES OF MERCHANTABILITY,
 * FITNESS FOR A PARTICULAR PURPOSE AND NONINFRINGEMENT. IN NO EVENT SHALL THE
 * AUTHORS OR COPYRIGHT HOLDERS BE LIABLE FOR ANY CLAIM, DAMAGES OR OTHER
 * LIABILITY, WHETHER IN AN ACTION OF CONTRACT, TORT OR OTHERWISE, ARISING FROM,
 * OUT OF OR IN CONNECTION WITH THE SOFTWARE OR THE USE OR OTHER DEALINGS IN THE
 * SOFTWARE.
 *
 */

#include "config.h"

#include <stdbool.h>
#include <stdint.h>
#include <zephyr/device.h>
#include <zephyr/drivers/flash.h>
#include <zephyr/fs/nvs.h>
#include <zephyr/logging/log.h>
#include <zephyr/storage/flash_map.h>
#include <zephyr/sys/crc.h>

LOG_MODULE_REGISTER(config, LOG_LEVEL_DBG);

#define NVS_PARTITION storage_partition
#define NVS_PARTITION_DEVICE FIXED_PARTITION_DEVICE(NVS_PARTITION)
#define NVS_PARTITION_OFFSET FIXED_PARTITION_OFFSET(NVS_PARTITION)

#define CONFIG_NVS_ID 0
#define MAGIC 0xBEEF
#define VERSION_MAJOR 1
#define VERSION_MINOR 0

#define SIZE_READ (CONFIG_SIZE_BUFFER)
#define SIZE_HEADER 6
#define SIZE_TAIL 4
#define SIZE_TLV_MAX (SIZE_READ - SIZE_HEADER - SIZE_TAIL)

#define OFFSET_MAGIC 0
#define OFFSET_MAJOR_VERSION 2
#define OFFSET_MINOR_VERSION 3

#define CONFIG_READ_DELAY 300

typedef struct __packed
{
    uint16_t magic;
    uint8_t major_version;
    uint8_t minor_version;
    uint16_t tlv_length;
} config_header_t;

typedef struct
{
    uint8_t *data;
} tlv_t;

static uint8_t _buffer[SIZE_READ];
static config_header_t *header = (config_header_t *)_buffer;
static tlv_t tlv;

static struct nvs_fs fs;

static int flash_init();
static int read_buffer();
static int check_data();
static int check_magic();
static int write_defaults();
static int check_crc();
static void write_crc();
static int find_field(config_field_t field);
static int read_value(config_field_t field, uint8_t size, void *value);
static int write_value(config_field_t field, uint8_t size, void *value);
static int insert_value(int field_pos, config_field_t field, uint8_t size, void *value);
static int append_value(config_field_t field, uint8_t size, void *value);

int config_init()
{
    int ret;

    ret = flash_init();
    if (ret != 0)
    {
        LOG_ERR("Failed to initialize flash: %d", ret);
        return -1;
    }

    k_msleep(CONFIG_READ_DELAY);
    ret = read_buffer();
    if (ret != 0)
    {
        LOG_ERR("Failed to read flash data: %d", ret);
        return -2;
    }

    tlv.data = &_buffer[SIZE_HEADER];

    ret = check_data();
    if (ret == 0)
    {
        LOG_INF("Configuration read and verified");
    }
    else
    {
        ret = write_defaults();
        if (ret != 0)
        {
            LOG_ERR("Failed to write default config to flash: %d", ret);
            return -3;
        }
        LOG_INF("Wrote default config to flash");
    }

    return 0;
}

int config_erase()
{
    if (nvs_delete(&fs, CONFIG_NVS_ID) != 0)
    {
        return -1;
    }

    return 0;
}

static int flash_init()
{
    struct flash_pages_info info;
    fs.flash_device = NVS_PARTITION_DEVICE;
    if (!device_is_ready(fs.flash_device))
    {
        LOG_ERR("Flash device is not ready");
        return -1;
    }
    fs.offset = NVS_PARTITION_OFFSET;
    if (flash_get_page_info_by_offs(fs.flash_device, fs.offset, &info) != 0)
    {
        LOG_ERR("Unabled to get page info");
        return -2;
    }
    fs.sector_size = info.size;
    fs.sector_count = 3U;
    if (nvs_mount(&fs) != 0)
    {
        LOG_ERR("Failed to mount flash");
        return -3;
    }

    int dummy_buffer[1];
    k_msleep(CONFIG_READ_DELAY);
    if (nvs_read(&fs, CONFIG_NVS_ID, &dummy_buffer, sizeof(dummy_buffer)) < 0)
    {
        if (nvs_write(&fs, CONFIG_NVS_ID, &dummy_buffer, sizeof(dummy_buffer)) < 0)
        {
            LOG_ERR("Failed to write null config");
            return -4;
        }
    }

    return 0;
}

static int read_buffer()
{
    int ret;
    ret = nvs_read(&fs, CONFIG_NVS_ID, &_buffer, SIZE_READ);
    if (ret < 0)
    {
        return ret;
    }

    return 0;
}

static int check_data()
{
    if (check_magic() != 0)
    {
        LOG_ERR("Magic not found");
        return -1;
    }

    if (header->tlv_length >= (SIZE_READ - SIZE_HEADER))
    {
        LOG_ERR("Data length mismatch");
        return -2;
    }

    return check_crc();
}

static int check_magic()
{
    const uint16_t magic = (MAGIC);
    if (memcmp(&header->magic, &magic, sizeof(uint16_t)))
    {
        LOG_ERR("header magic: %u, magic: %u", header->magic, magic);
        return -1;
    }

    return 0;
}

static int write_defaults()
{
    const uint16_t magic = (MAGIC);
    memcpy(&_buffer[OFFSET_MAGIC], &magic, sizeof(uint16_t));

    _buffer[OFFSET_MAJOR_VERSION] = VERSION_MAJOR;
    _buffer[OFFSET_MINOR_VERSION] = VERSION_MINOR;

    write_crc();

    if (nvs_write(&fs, CONFIG_NVS_ID, &_buffer, SIZE_READ) < 0)
    {
        return -1;
    }

    k_msleep(CONFIG_READ_DELAY);
    if (read_buffer() != 0)
    {
        return -2;
    }

    if (check_data() != 0)
    {
        return -3;
    }

    return 0;
}

static int check_crc()
{
    const int total_length = SIZE_HEADER + header->tlv_length;
    uint32_t buffer_checksum;
    memcpy(&buffer_checksum, &_buffer[SIZE_HEADER + header->tlv_length], sizeof(uint32_t));
    uint32_t checksum = crc32_ieee(_buffer, total_length);

    if (buffer_checksum != checksum)
    {
        LOG_ERR("Checksums do not match. Reference: %u, Calculated: %u", buffer_checksum, checksum);
        return -1;
    }

    return 0;
}

static void write_crc()
{
    uint32_t checksum = crc32_ieee(_buffer, SIZE_HEADER + header->tlv_length);
    memcpy(&_buffer[SIZE_HEADER + header->tlv_length], &checksum, sizeof(uint32_t));
}

static int find_field(config_field_t field)
{
    int pos = 0;
    while (pos < header->tlv_length)
    {
        if (tlv.data[pos] == field)
        {
            return pos;
        }

        pos += tlv.data[pos + 1] + 2;
    }

    return -1;
}

int config_refresh()
{
    k_msleep(CONFIG_READ_DELAY);
    if (read_buffer() != 0)
    {
        LOG_ERR("Failed to refresh config");
        return -1;
    }

    return 0;
}

void config_buffer(uint8_t *buffer, size_t size)
{
    size_t read_size = MIN(size, SIZE_READ);
    memcpy(buffer, &_buffer, read_size);
}

int config_field_size(config_field_t field, uint8_t *size)
{
    int pos = find_field(field);
    if (pos < 0)
    {
        return -1;
    }

    *size = tlv.data[pos + 1];

    return 0;
}

int read_value(config_field_t field, uint8_t size, void *value)
{
    int pos = find_field(field);
    if (pos < 0)
    {
        return -1;
    }
    if (pos + 2 + size >= (SIZE_TLV_MAX))
    {
        LOG_ERR("Field size exceeds maximum TLV length");
        return -2;
    }
    if (size != tlv.data[pos + 1])
    {
        LOG_ERR("Field size mismatch when reading");
        return -3;
    }
    memcpy(value, &tlv.data[pos + 2], size);

    return 0;
}

int write_value(config_field_t field, uint8_t size, void *value)
{
    const int bytes_to_insert = 2 + size;
    const int bytes_avaliable = SIZE_TLV_MAX - header->tlv_length;
    if (bytes_to_insert > bytes_avaliable)
    {
        LOG_ERR("Cannot add value to flash, not enough space");
        return -1;
    }

    int bytes_inserted = 0;
    int pos = find_field(field);
    if (pos > -1)
    {
        bytes_inserted = insert_value(pos, field, size, value);
    }
    else
    {
        bytes_inserted = append_value(field, size, value);
    }

    if (bytes_inserted < 0)
    {
        LOG_ERR("Failed to insert value into buffer");
        return -2;
    }

    write_crc();
    ssize_t bytes_written = nvs_write(&fs, CONFIG_NVS_ID, &_buffer, SIZE_READ);
    if (bytes_written < 0)
    {
        LOG_ERR("Failed to write value to flash");
        return -3;
    }

    k_msleep(CONFIG_READ_DELAY);
    if (read_buffer() != 0)
    {
        LOG_ERR("Failed to re-read buffer after write");
        return -4;
    }

    return 0;
}

static int insert_value(int field_pos, config_field_t field, uint8_t size, void *value)
{
    const int bytes_to_insert = 2 + size;
    const int bytes_avaliable = SIZE_TLV_MAX - header->tlv_length;
    if (bytes_to_insert > bytes_avaliable)
    {
        LOG_ERR("Field size exceeds maximum TLV length");
        return -1;
    }

    uint8_t old_size = tlv.data[field_pos + 1];
    if (memcmp(&tlv.data[field_pos + 2], value, size) != 0 || size != old_size)
    {
        if (size != old_size) // shift data
        {
            const int src_idx = field_pos + 2 + old_size;
            const int dest_idx = field_pos + 2 + size;
            const size_t move_size = header->tlv_length - (field_pos + 2 + old_size);
            memmove(&tlv.data[dest_idx], &tlv.data[src_idx], move_size);
        }

        tlv.data[field_pos] = field;
        tlv.data[field_pos + 1] = size;
        memcpy(&tlv.data[field_pos + 2], value, size);
        header->tlv_length += size - old_size;
    }

    return size;
}

static int append_value(config_field_t field, uint8_t size, void *value)
{
    const int bytes_to_insert = 2 + size;
    const int bytes_avaliable = SIZE_TLV_MAX - header->tlv_length;
    if (bytes_to_insert > bytes_avaliable)
    {
        LOG_ERR("Field size exceeds maximum TLV length");
        return -1;
    }

    tlv.data[header->tlv_length] = field;
    tlv.data[header->tlv_length + 1] = size;
    memcpy(&tlv.data[header->tlv_length + 2], value, size);
    header->tlv_length += bytes_to_insert;

    return size;
}

// TODO check bounds when passing in uint8_t length
int config_read_u8(config_field_t field, uint8_t *value)
{
    return read_value(field, sizeof(uint8_t), value);
}

int config_read_u16(config_field_t field, uint16_t *value)
{
    return read_value(field, sizeof(uint16_t), value);
}

int config_read_u32(config_field_t field, uint32_t *value)
{
    return read_value(field, sizeof(uint32_t), value);
}

int config_read_u64(config_field_t field, uint64_t *value)
{
    return read_value(field, sizeof(uint64_t), value);
}

int config_read_float(config_field_t field, float *value)
{
    return read_value(field, sizeof(float), value);
}

int config_read_double(config_field_t field, double *value)
{
    return read_value(field, sizeof(double), value);
}

int config_write_u8(config_field_t field, uint8_t value)
{
    return write_value(field, sizeof(uint8_t), &value);
}

int config_write_u16(config_field_t field, uint16_t value)
{
    return write_value(field, sizeof(uint16_t), &value);
}

int config_write_u32(config_field_t field, uint32_t value)
{
    return write_value(field, sizeof(uint32_t), &value);
}

int config_write_u64(config_field_t field, uint64_t value)
{
    return write_value(field, sizeof(uint64_t), &value);
}

int config_write_float(config_field_t field, float value)
{
    return write_value(field, sizeof(float), &value);
}

int config_write_double(config_field_t field, double value)
{
    return write_value(field, sizeof(double), &value);
}

int config_read_u8_array(config_field_t field, uint8_t length, uint8_t *array)
{
    return read_value(field, sizeof(uint8_t) * length, array);
}

int config_read_u16_array(config_field_t field, uint8_t length, uint16_t *array)
{
    return read_value(field, sizeof(uint16_t) * length, array);
}

int config_read_u32_array(config_field_t field, uint8_t length, uint32_t *array)
{
    return read_value(field, sizeof(uint32_t) * length, array);
}

int config_read_u64_array(config_field_t field, uint8_t length, uint64_t *array)
{
    return read_value(field, sizeof(uint64_t) * length, array);
}

int config_read_float_array(config_field_t field, uint8_t length, float *array)
{
    return read_value(field, sizeof(float) * length, array);
}

int config_read_double_array(config_field_t field, uint8_t length, double *array)
{
    return read_value(field, sizeof(double) * length, array);
}

int config_write_u8_array(config_field_t field, uint8_t length, uint8_t *array)
{
    return write_value(field, sizeof(uint8_t) * length, array);
}

int config_write_u16_array(config_field_t field, uint8_t length, uint16_t *array)
{
    return write_value(field, sizeof(uint16_t) * length, array);
}

int config_write_u32_array(config_field_t field, uint8_t length, uint32_t *array)
{
    return write_value(field, sizeof(uint32_t) * length, array);
}

int config_write_u64_array(config_field_t field, uint8_t length, uint64_t *array)
{
    return write_value(field, sizeof(uint64_t) * length, array);
}

int config_write_float_array(config_field_t field, uint8_t length, float *array)
{
    return write_value(field, sizeof(float) * length, array);
}

int config_write_double_array(config_field_t field, uint8_t length, double *array)
{
    return write_value(field, sizeof(double) * length, array);
}
```

## src/hashmap.c
```c
/**
 * @file hashmap.c
 * @author Nicholas Loehrke (nicholasnloehrke@gmail.com)
 * @brief
 * @version 1.0.0
 * @date 2024-04-12
 *
 * MIT License
 *
 * Copyright (c) 2024 Nicholas Loehrke
 *
 * Permission is hereby granted, free of charge, to any person obtaining a copy
 * of this software and associated documentation files (the "Software"), to deal
 * in the Software without restriction, including without limitation the rights
 * to use, copy, modify, merge, publish, distribute, sublicense, and/or sell
 * copies of the Software, and to permit persons to whom the Software is
 * furnished to do so, subject to the following conditions:
 *
 * The above copyright notice and this permission notice shall be included in all
 * copies or substantial portions of the Software.
 *
 * THE SOFTWARE IS PROVIDED "AS IS", WITHOUT WARRANTY OF ANY KIND, EXPRESS OR
 * IMPLIED, INCLUDING BUT NOT LIMITED TO THE WARRANTIES OF MERCHANTABILITY,
 * FITNESS FOR A PARTICULAR PURPOSE AND NONINFRINGEMENT. IN NO EVENT SHALL THE
 * AUTHORS OR COPYRIGHT HOLDERS BE LIABLE FOR ANY CLAIM, DAMAGES OR OTHER
 * LIABILITY, WHETHER IN AN ACTION OF CONTRACT, TORT OR OTHERWISE, ARISING FROM,
 * OUT OF OR IN CONNECTION WITH THE SOFTWARE OR THE USE OR OTHER DEALINGS IN THE
 * SOFTWARE.
 *
 */

#include "hashmap.h"

#include <assert.h>
#include <zephyr/kernel.h>
#include <zephyr/logging/log.h>
#include <zephyr/sys/printk.h>

LOG_MODULE_REGISTER(hashmap, LOG_LEVEL_DBG);

#define HASH_MAX_BUCKETS 128

_Static_assert(HASH_MAX_BUCKETS > HASH_CAPACITY, "Invalid HASH_CAPACITY");

typedef struct
{
    uint8_t key[HASH_KEY_SIZE];
    hash_value_t value;
    bool occupied;
} hash_bucket_t;

static hash_bucket_t buckets[HASH_MAX_BUCKETS];

static size_t occupied_count = 0;

static uint32_t hash(uint8_t key[HASH_KEY_SIZE]);

void hash_init()
{
    for (int i = 0; i < HASH_MAX_BUCKETS; ++i)
    {
        buckets[i].occupied = false;
    }

    occupied_count = 0;
}

int hash_insert(uint8_t key[HASH_KEY_SIZE], hash_value_t *value)
{
    if (occupied_count >= HASH_CAPACITY)
        return -1;

    int index = hash(key) % HASH_MAX_BUCKETS;
    for (int i = 0; i < HASH_MAX_BUCKETS; ++i)
    {
        int try = (index + i) % HASH_MAX_BUCKETS;
        if (buckets[try].occupied && memcmp(buckets[try].key, key, HASH_KEY_SIZE) == 0)
        {
            memcpy(&buckets[try].value, value, sizeof(hash_value_t));
            return 0;
        }

        if (!buckets[try].occupied)
        {
            memcpy(buckets[try].key, key, HASH_KEY_SIZE);
            memcpy(&buckets[try].value, value, sizeof(hash_value_t));
            buckets[try].occupied = true;
            ++occupied_count;
            return 0;
        }
    }

    return -2;
}

int hash_get(uint8_t key[HASH_KEY_SIZE], hash_value_t *value)
{
    int index = hash(key) % HASH_MAX_BUCKETS;
    for (int i = 0; i < HASH_MAX_BUCKETS; ++i)
    {
        int try = (index + i) % HASH_MAX_BUCKETS;
        if (buckets[try].occupied && memcmp(buckets[try].key, key, HASH_KEY_SIZE) == 0)
        {
            *value = buckets[try].value;
            return 0;
        }
    }

    return -1;
}

int hash_remove(uint8_t key[HASH_KEY_SIZE])
{
    int index = hash(key) % HASH_MAX_BUCKETS;
    for (int i = 0; i < HASH_MAX_BUCKETS; ++i)
    {
        int try = (index + i) % HASH_MAX_BUCKETS;
        if (buckets[try].occupied && memcmp(buckets[try].key, key, HASH_KEY_SIZE) == 0)
        {
            buckets[try].occupied = false;
            --occupied_count;
            return 0;
        }
    }

    return -1;
}

bool hash_empty()
{
    return occupied_count == 0;
}

size_t hash_available()
{
    return HASH_CAPACITY - occupied_count;
}

static uint32_t hash(uint8_t key[HASH_KEY_SIZE])
{
#define FNV_PRIME 0x01000193
#define FNV_OFFSET_BASIS 0x811c9dc5

    uint32_t h = FNV_OFFSET_BASIS;
    for (int i = 0; i < HASH_KEY_SIZE; ++i)
    {
        h ^= key[i];
        h *= FNV_PRIME;
    }

    return h;
}

// testing code
void hash_printk()
{
    for (int i = 0; i < HASH_MAX_BUCKETS; ++i)
    {
        hash_bucket_t b = buckets[i];
        if (b.occupied)
        {
            printk("~~~~~~~~~~~~bucket %d~~~~~~~~~~~~\n", i);
            printk("key:      %u:%u:%u:%u:%u:%u:%u:%u\n", b.key[0], b.key[1], b.key[2], b.key[3], b.key[4], b.key[5], b.key[6], b.key[7]);
            printk("value:    %d\n", b.value.n);
            printk("occupied: %d\n\n", b.occupied);

            k_msleep(50);
        }
    }

    printk("done.\n\n\n");
}
```

## src/uwb_dummy.c
```c
/**
 * @file uwb_dummy.c
 * @author Nicholas Loehrke (nicholasnloehrke@gmail.com)
 * @brief
 * @version 1.0.0
 * @date 2024-03-19
 *
 * MIT License
 *
 * Copyright (c) 2024 Nicholas Loehrke
 *
 * Permission is hereby granted, free of charge, to any person obtaining a copy
 * of this software and associated documentation files (the "Software"), to deal
 * in the Software without restriction, including without limitation the rights
 * to use, copy, modify, merge, publish, distribute, sublicense, and/or sell
 * copies of the Software, and to permit persons to whom the Software is
 * furnished to do so, subject to the following conditions:
 *
 * The above copyright notice and this permission notice shall be included in all
 * copies or substantial portions of the Software.
 *
 * THE SOFTWARE IS PROVIDED "AS IS", WITHOUT WARRANTY OF ANY KIND, EXPRESS OR
 * IMPLIED, INCLUDING BUT NOT LIMITED TO THE WARRANTIES OF MERCHANTABILITY,
 * FITNESS FOR A PARTICULAR PURPOSE AND NONINFRINGEMENT. IN NO EVENT SHALL THE
 * AUTHORS OR COPYRIGHT HOLDERS BE LIABLE FOR ANY CLAIM, DAMAGES OR OTHER
 * LIABILITY, WHETHER IN AN ACTION OF CONTRACT, TORT OR OTHERWISE, ARISING FROM,
 * OUT OF OR IN CONNECTION WITH THE SOFTWARE OR THE USE OR OTHER DEALINGS IN THE
 * SOFTWARE.
 *
 */

#include "uwb.h"

#include <zephyr/logging/log.h>

LOG_MODULE_REGISTER(dummy, LOG_LEVEL_DBG);

static void dummy_init(uwb_config_t *config);
static uint32_t dummy_on_event(uwb_event_t event);

static void dummy_init(uwb_config_t *config)
{
    LOG_DBG("Dummy init");
}

static uint32_t dummy_on_event(uwb_event_t event)
{
    LOG_DBG("Dummy on event");
    return UWB_TIMEOUT_MAXIMUM;
}

uwb_algorithm_t uwb_dummy_algorithm = {
    .init = dummy_init,
    .on_event = dummy_on_event};
```
